/dts-v1/;
/plugin/;

/ {
	compatible = "brcm,bcm2711";

	fragment@0 {
		target = <&i2c1>;
		__overlay__ {
			#address-cells = <1>;
			#size-cells = <0>;
			status = "okay";

			sht45@44 {
				compatible = "sensirion,sht4x";
				reg = <0x44>;
			};
		};
	};
};
