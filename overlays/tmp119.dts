/dts-v1/;
/plugin/;

/ {
	compatible = "brcm,bcm2711";

	fragment@0 {
		target = <&i2c1>;
		__overlay__ {
			#address-cells = <1>;
			#size-cells = <0>;
			status = "okay";

			tmp119@48 {
				compatible = "ti,tmp119";
				reg = <0x48>;
			};
		};
	};
};
