/dts-v1/;
/plugin/;

/ {
	compatible = "brcm,bcm2711";

	fragment@0 {
		target = <&i2c1>;
		__overlay__ {
			#address-cells = <1>;
			#size-cells = <0>;

			sgp40@59 {
				compatible = "sensirion,sgp40";
				reg = <0x59>;
			};
		};
	};
};
