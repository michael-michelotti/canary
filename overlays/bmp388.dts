/dts-v1/;
/plugin/;

/ {
	compatible = "brcm,bcm2711";

	fragment@0 {
		target = <&i2c1>;
		__overlay__ {
			#address-cells = <1>;
			#size-cells = <0>;
			status = "okay";

			bmp388@77 {
				compatible = "bosch,bmp380";
				reg = <0x77>;
			};
		};
	};
};
